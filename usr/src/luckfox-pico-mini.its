## usr/src/luckfox-pico-mini.its
```
/*
 * Copyright (C) 2021 Rockchip Electronics Co., Ltd
 *
 * SPDX-License-Identifier: GPL-2.0
 */

/dts-v1/;
/ {
    description = "FIT image with Linux kernel and FDT blob";

    images {
        fdt {
            data = /incbin/("fdt");
            type = "flat_dt";
            arch = "arm";
            compression = "none";
            load = <0x00c00000>;

            hash {
                algo = "sha256";
            };
        };

        kernel {
            data = /incbin/("Image.gz");
            type = "kernel";
            arch = "arm";
            os = "linux";
            compression = "gzip";
            entry = <0x00008000>;
            load = <0x00008000>;

            hash {
                algo = "sha256";
            };
        };
    };

    configurations {
        default = "conf";

        conf {
            rollback-index = <0x00>;
            fdt = "fdt";
            kernel = "kernel";

            signature {
                algo = "sha256,rsa2048";
                padding = "pss";
                key-name-hint = "dev";
                sign-images = "fdt", "kernel";
            };
        };
    };
};
```
